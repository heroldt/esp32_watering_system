## main/Kconfig.projbuild
```kconfig
# put here your custom config value
menu "Configuration"
config ESP_WIFI_SSID
    string "WiFi SSID"
    default "myssid"
    help
	SSID (network name) for the example to connect to.

config ESP_WIFI_PASSWORD
    string "WiFi Password"
    default "mypassword"
    help
	WiFi password (WPA or WPA2) for the example to use.
	
config MQTT_HOSTNAME
  	string "MQTT Hostname"
    default "mqtt.eclipse.org"
    help
	Address of MQTT Broker to use.
endmenu
```
